## config/west.yml
```yaml
manifest:
  defaults:
    revision: v0.3
  remotes:
    - name: zmkfirmware
      url-base: https://github.com/zmkfirmware
    # Additional modules containing boards/shields/custom code can be listed here as well
    # See https://docs.zephyrproject.org/3.2.0/develop/west/manifest.html#projects
  projects:
    - name: zmk
      remote: zmkfirmware
      import: app/west.yml
    - name: mikoto
      url: https://github.com/zhiayang/mikoto
      revision: master
      path: modules/mikoto
    - name: m122_keyboard
      url: https://github.com/SvenHaedrich/m122_keyboard
      revision: main
      path: modules/m122_keyboard
  self:
    path: config
```
